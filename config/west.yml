## config/west.yml
```yaml
manifest:
  remotes:
    # zmk official
    - name: zmkfirmware
      url-base: https://github.com/zmkfirmware
    # kyek / duckyb
    - name: duckyb
      url-base: https://github.com/duckyb
    # urob
    - name: urob
      url-base: https://github.com/urob
  projects:
    - name: zmk
      remote: zmkfirmware
      revision: v0.3.0 # kyek's repo has locked this into v0.3... need to investigate if the latest version would not build
      import: app/west.yml
    - name: urchin-zmk-module # provides the urchin_left/urchin_right shield definitions — not in ZMK mainline
      remote: duckyb
      revision: main
    - name: zmk-tri-state
      remote: urob
      revision: v0.3
    - name: zmk-auto-layer
      remote: urob
      revision: v0.3
  self:
    path: config
```
